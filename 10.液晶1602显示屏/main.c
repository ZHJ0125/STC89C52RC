
/**********************BST-V51实验开发板例程************************
*  平台：BST-V51 + Keil U5 + STC89C52
*  名称：LCD1602模块实验
*  公司：深圳市亚博智能科技有限公司
*  修改日期：2019-9-8
*  晶振:11.0592MHZ
*  说明：免费开源，不提供源代码分析
*				 ZhangHJ于2019-9-8进行测试,并修改部分代码注释
*******************************************************************/

/**********************实验测试程序*********************************
*  平台：BST-V51 + Keil U5 + STC89C52RC
*  名称：液晶1602显示屏实验
*  日期：2019-9-8
*  姓名：ZhangHJ
*	 内容：通过标准程序静态显示字符
*	 引脚定义如下：1-VSS 2-VDD 3-V0 4-RS 5-R/W 6-E 7-14 DB0-DB7 15-BLA 16-BLK
********************************************************************/

#include<reg52.h> //包含头文件，一般情况不需要改动，头文件包含特殊功能寄存器的定义
#include<intrins.h>

sbit RS = P1^0;   //定义端口
sbit RW = P1^1;
sbit EN = P2^5;
sbit DU = P2^0;		//重新进行段选和位选地址的定义
sbit WE = P2^1;

#define RS_CLR RS=0
#define RS_SET RS=1

#define RW_CLR RW=0
#define RW_SET RW=1

#define EN_CLR EN=0
#define EN_SET EN=1

#define DataPort P0	//定义数据端口


/**********************************************************
*  函数名称：关数码管点阵函数
*  修改日期：2019-9-8
*  修改人：ZhangHJ
*  说明：段选关闭所有数码管数据段
***********************************************************/
void cmg88()		//关数码管，点阵函数
{
	P0=0X00;
	DU=1;
	DU=0;
}



/**********************************************************
*  函数名称：微秒延时函数
*  修改日期：2019-9-8
*  修改人：ZhangHJ
*  说明：uS延时函数，含有输入参数 unsigned char t,无返回值
*				 unsigned char 是定义无符号字符变量,其值的范围是
*				 0~255 这里使用晶振12M,精确延时请使用汇编,大致延时
*				 长度如下 T=tx2+5 uS
***********************************************************/
void DelayUs2x(unsigned char t)
{
	while(--t);
}



/**********************************************************
*  函数名称：毫秒延时函数
*  修改日期：2019-9-8
*  修改人：ZhangHJ
*  说明：mS延时函数,含有输入参数 unsigned char t,无返回值
*				 unsigned char 是定义无符号字符变量,其值的范围是
*				 0~255 这里使用晶振12M,精确延时请使用汇编
***********************************************************/
void DelayMs(unsigned char t)
{
	while(t--)
	{
		//大致延时1mS
		DelayUs2x(245);
		DelayUs2x(245);
	}
}



/**********************************************************
*  函数名称：判断1602液晶屏是否繁忙函数
*  修改日期：2019-9-8
*  修改人：ZhangHJ
*  说明：对液晶屏进行操作前,必须首先进行液晶屏当前是否繁忙的读写检测
*				 返回值为 1 --> 禁止读写
*				 					0 --> 允许读写
***********************************************************/
bit LCD_Check_Busy(void) 
{
	DataPort = 0xFF;			//数据端口赋值 1111 1111
	RS_CLR;								//RS --> 0
	RW_SET;								//RW --> 1
	EN_CLR;								//EN --> 0
	_nop_();							//等待
	EN_SET;								//EN --> 1
	return (bit)(DataPort & 0x80);
}



/**********************************************************
*  函数名称：命令写入函数
*  修改日期：2019-9-8
*  修改人：ZhangHJ
*  说明：向1602写入命令com
*				 首先判断1602是否允许写入,禁止写入则进行等待
*				 
***********************************************************/
void LCD_Write_Com(unsigned char com) 
{
	while(LCD_Check_Busy());	//忙则等待
	RS_CLR;										//RS --> 0
	RW_CLR;										//RW --> 0
	EN_SET;										//EN --> 1
	DataPort = com;						//命令赋值到数据端口
	_nop_();									//等待
	EN_CLR;										//EN --> 0
}



/**********************************************************
*  函数名称：数据写入函数
*  修改日期：2019-9-8
*  修改人：ZhangHJ
*  说明：向1602写入数据Data
*				 首先判断1602是否允许写入,禁止写入则进行等待
*				 
***********************************************************/
void LCD_Write_Data(unsigned char Data)
{
	while(LCD_Check_Busy()); 	//忙则等待
	RS_SET;										//RS --> 1
	RW_CLR;										//RW --> 0
	EN_SET;										//EN --> 1
	DataPort = Data;					//命令赋值到数据端口
	_nop_();									//等待
	EN_CLR;										//EN --> 0
}



/**********************************************************
*  函数名称：清屏函数
*  修改日期：2019-9-8
*  修改人：ZhangHJ
*  说明：将1602清屏
*				 调用命令写入函数,写入01H命令,延时等待5ms
*				 命令详见1602资料4.2.4节
***********************************************************/
void LCD_Clear(void)
{
	LCD_Write_Com(0x01);
	DelayMs(5);
}



/**********************************************************
*  函数名称：字符串写入函数
*  修改日期：2019-9-8
*  修改人：ZhangHJ
*  说明：将在第 y 行, x 列写入字符串 s
*				 首先设置数据地址指针,之后按位逐位写入字符串数据
*				 命令详见1602资料4.2.1节
***********************************************************/
void LCD_Write_String(unsigned char x,unsigned char y,unsigned char *s)
{
	//1. 设置数据地址指针
	if (y == 0)//表示第一行
	{
		LCD_Write_Com(0x80 + x);		//第一行起始地址0x80 + 数据偏移地址
	}
	else//表示第二行
	{
		LCD_Write_Com(0xC0 + x);		//第二行起始地址0xC0 + 数据偏移地址
	}
	
	//2. 逐位写入字符串数据
	while(*s)
	{
		LCD_Write_Data(*s);
		s ++;
	}
}



/**********************************************************
*  函数名称：字符写入函数
*  修改日期：2019-9-8
*  修改人：ZhangHJ
*  说明：将在第 y 行, x 列写入字符 s
*				 首先设置数据地址指针,之后按位逐位写入字符串数据
*				 命令详见1602资料4.2.1节
***********************************************************/
void LCD_Write_Char(unsigned char x,unsigned char y,unsigned char Data)
{
	//1. 设置数据地址指针
	if (y == 0)									//表示第一行
	{
		LCD_Write_Com(0x80 + x);	//第一行起始地址0x80 + 数据偏移地址
	}
	else												//表示第二行
	{
		LCD_Write_Com(0xC0 + x);	//第二行起始地址0xC0 + 数据偏移地址
	}
	
	//2. 逐位写入字符串数据
	LCD_Write_Data(Data);
}



/**********************************************************
*  函数名称：1602液晶屏初始化函数
*  修改日期：2019-9-8
*  修改人：ZhangHJ
*  说明：1602液晶屏初始化
*				 命令详见1602资料5节
***********************************************************/
void LCD_Init(void)
{
	LCD_Write_Com(0x38);    /*显示模式设置*/
	DelayMs(5);
	LCD_Write_Com(0x38);
	DelayMs(5);
	LCD_Write_Com(0x38);
	DelayMs(5);
	LCD_Write_Com(0x38);
	LCD_Write_Com(0x08);    /*显示关闭*/
	LCD_Write_Com(0x01);    /*显示清屏*/
	LCD_Write_Com(0x06);    /*显示光标移动设置*/
	DelayMs(5);
	LCD_Write_Com(0x0C);    /*显示开及光标设置*/
}



/**********************************************************
*  函数名称：1602液晶屏测试主函数
*  修改日期：2019-9-8
*  修改人：ZhangHJ
*  说明：1602液晶屏字符和字符串写入测试
*				 
***********************************************************/
void main(void)
{
	cmg88();								//关数码管，点阵函数
	LCD_Init();							//初始化
	LCD_Clear();						//清屏
	while (1)
	{
//		LCD_Write_Char(7,0,'o');
//		LCD_Write_Char(8,0,'k');
		LCD_Write_String(2,0,"Zhang HouJin");
		LCD_Write_String(2,1,"Hello World!");
		while(1);
	}
}

